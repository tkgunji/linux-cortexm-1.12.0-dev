## linux/drivers/i2c/chips/Kconfig
```kconfig
#
# Miscellaneous I2C chip drivers configuration
#
# *** DEPRECATED! Do not add new entries! See Makefile ***
#

menu "Miscellaneous I2C Chip support"

config SENSORS_TSL2550
	tristate "Taos TSL2550 ambient light sensor"
	depends on EXPERIMENTAL
	help
	  If you say yes here you get support for the Taos TSL2550
	  ambient light sensor.

	  This driver can also be built as a module.  If so, the module
	  will be called tsl2550.

config SENSORS_AD7417
	tristate "AD7417 sensor"
	depends on EXPERIMENTAL
	help
	  If you say yes here you get support for the AD7417 sensor.

	  This driver can also be built as a module.  If so, the module
	  will be called ad7417

config SENSORS_SHT25
	tristate "SHT25 sensor"
	depends on EXPERIMENTAL
	help
	  If you say yes here you get support for the SHT25 sensor.

	  This driver can also be built as a module.  If so, the module
	  will be called sht25

endmenu
```
